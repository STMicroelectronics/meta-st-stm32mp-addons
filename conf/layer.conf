## conf/layer.conf
```bitbake
# We have a conf and classes directory, add to BBPATH
BBPATH .= ":${LAYERDIR}"

# We have a recipes-* directories, add to BBFILES
BBFILES += "${LAYERDIR}/recipes-*/*/*.bb \
	${LAYERDIR}/recipes-*/*/*.bbappend"

BBFILE_COLLECTIONS += "stm-st-stm32mp-mx"
BBFILE_PATTERN_stm-st-stm32mp-mx := "^${LAYERDIR}/"
BBFILE_PRIORITY_stm-st-stm32mp-mx = "7"

EULA_FILE_ST_stm32mpcommonmx = "${LAYERDIR}/conf/eula/${MACHINE}"
EULA_FILE_ST_MD5SUM_stm32mpcommonmx = "8b505090fb679839cefbcc784afe8ce9"

# This should only be incremented on significant changes that will
# cause compatibility issues with other layers
LAYERVERSION_stm-st-stm32mp-mx = "1"
LAYERSERIES_COMPAT_stm-st-stm32mp-mx = "zeus dunfell"

LAYERDEPENDS_stm-st-stm32mp-mx = "stm-st-stm32mp"

# OpenSTLinux compatibility version
ST_OSTL_COMPATIBILTY_VERSION_stm-st-stm32mp-mx = "3.1"
```

## conf/machine/include/stm32mp1-mx-common.inc
```bitbake
# Common parameters for all mx machines
# =========================================================================
# Chip architecture
# =========================================================================
DEFAULTTUNE = "cortexa7thf-neon-vfpv4"
include conf/machine/include/tune-cortexa7.inc

# Define specific common machine name
MACHINEOVERRIDES .= ":stm32mpcommonmx"

# Mandatory to define these variables as they are used for extlinux part
CUBEMX_DTB ?= ""
CUBEMX_DTB_PATH ?= "${STM32MP_MX_BASE}/mx/${CUBEMX_PROJECT}"

# Configure devicetree file name to use
CUBEMX_DTB_SET = "${@'${CUBEMX_DTB}' if d.getVar('CUBEMX_PROJECT') else '${CUBEMX_BOARD_REFERENCE}'}"

# Define list of devicetree per board
CUBEMX_DISCO = "${@bb.utils.contains_any('CUBEMX_BOARD_REFERENCE', 'stm32mp157c-dk2 stm32mp157a-dk1', '1', '0', d)}"
STM32MP_DT_FILES_EV += "${@'' if ${CUBEMX_DISCO} else '${CUBEMX_DTB_SET}'}"
STM32MP_DT_FILES_DK += "${@'${CUBEMX_DTB_SET}' if ${CUBEMX_DISCO} else ''}"

# =========================================================================
# Machine features
# =========================================================================
# Bluetooth, wifi only available on DISCO DK2 boards
MACHINE_FEATURES += "${@bb.utils.contains('CUBEMX_BOARD_REFERENCE', 'stm32mp157c-dk2', 'bluetooth', '', d)}"
MACHINE_FEATURES += "${@bb.utils.contains('CUBEMX_BOARD_REFERENCE', 'stm32mp157c-dk2', 'wifi', '', d)}"
MACHINE_FEATURES += "${@'gpu' if d.getVar('ACCEPT_EULA_'+d.getVar('MACHINE')) == '1' else ''}"
# Splashscreen enabled
MACHINE_FEATURES += "splashscreen"

# =========================================================================
# Image
# =========================================================================
# Add ubi FSTYPES to default ones for nand volumes
IMAGE_FSTYPES += "${@bb.utils.contains_any('BOOTDEVICE_LABELS', 'nand-4-256 nor-nand-4-256', 'stmultiubi', '', d)}"

# =========================================================================
# Kernel
# =========================================================================
# Kernel config
# Set this address to 0xC2000040, which is 0xC2000000 + 0x40.
# 0xC2000000 is the memory address where U-Boot will copy from flash the file uImage and 0x40 is uImage header size (64Bytes).
# With this value, U-Boot will be able to execute in place the zImage contained in uImage.
ST_KERNEL_LOADADDR   = "0xC2000040"

# For eval board: auto-load goodix module (touchscreen module)
KERNEL_MODULE_AUTOLOAD = "${@bb.utils.contains('CUBEMX_BOARD_REFERENCE', 'stm32mp157c-ev1', 'goodix', '', d)}"

# Kernel device tree: make sure to always have the default eval board device tree
STM32MP_KERNEL_DEVICETREE_append = " ${CUBEMX_BOARD_REFERENCE}.dtb "

# Define the devicetree for Linux A7 examples
#LINUX_A7_EXAMPLES_DT += "${CUBEMX_BOARD_REFERENCE}-m4-examples"
#Should be replaced later by the line upper if we have specificity for DK1
LINUX_A7_EXAMPLES_DT += "${@bb.utils.contains('CUBEMX_BOARD_REFERENCE', 'stm32mp157c-ev1', 'stm32mp157c-ev1-a7-examples', '', d)}"
LINUX_A7_EXAMPLES_DT += "${@bb.utils.contains('CUBEMX_BOARD_REFERENCE', 'stm32mp157c-dk2', 'stm32mp157c-dk2-a7-examples', '', d)}"

# =========================================================================
# M4 copro
# =========================================================================
# Define the devicetree for M4 example
#CUBE_M4_EXAMPLES_DT += "${CUBEMX_BOARD_REFERENCE}-m4-examples"
#Should be replaced later by the line upper if we have specificity for DK1
CUBE_M4_EXAMPLES_DT += "${@bb.utils.contains('CUBEMX_BOARD_REFERENCE', 'stm32mp157c-ev1', 'stm32mp157c-ev1-m4-examples', '', d)}"
CUBE_M4_EXAMPLES_DT += "${@bb.utils.contains('CUBEMX_BOARD_REFERENCE', 'stm32mp157c-dk2', 'stm32mp157c-dk2-m4-examples', '', d)}"

# Define specific board reference to use
#M4_BOARDS = "STM32MP157C-EV1"
#M4_BOARDS = "${@d.getVar('CUBEMX_BOARD_REFERENCE').upper()}"
#Should be replaced later by the line upper if we have specificity for DK1
#For the moment we are using same examples for dk1 and dk2
M4_BOARDS += "${@bb.utils.contains('CUBEMX_BOARD_REFERENCE', 'stm32mp157c-ev1', 'STM32MP157C-EV1', '', d)}"
M4_BOARDS += "${@bb.utils.contains('CUBEMX_BOARD_REFERENCE', 'stm32mp157a-dk1', 'STM32MP157C-DK2', '', d)}"
M4_BOARDS += "${@bb.utils.contains('CUBEMX_BOARD_REFERENCE', 'stm32mp157c-dk2', 'STM32MP157C-DK2', '', d)}"
```

## conf/machine/include/stm32mp1-mx-config.inc
```bitbake
#
# Internal Test Config
#

# Boot Scheme
# =========================================================================
# DISCO / EVAL : basic, trusted or optee
# =========================================================================
BOOTSCHEME_LABELS ?= "trusted"

# Boot Device Choice
# =========================================================================
# DISCO : sdcard
# EVAL  : sdcard, emmc, nand-4-256, nor-sdcard, nor-emmc or nor-nand-4-256
# =========================================================================
# Define the config labels to use to generate flashlayout file
BOOTDEVICE_LABELS ?= "sdcard"

# Configs below only available with EVAL board
#BOOTDEVICE_LABELS ?= "emmc"
#BOOTDEVICE_LABELS ?= "nand-4-256"
#BOOTDEVICE_LABELS ?= "nor-emmc"
#BOOTDEVICE_LABELS ?= "nor-nand-4-256"
#BOOTDEVICE_LABELS ?= "nor-sdcard"

# Board Type Choice
# =========================================================================
# DISCO : stm32mp157a-dk1 or stm32mp157c-dk2
# EVAL  : stm32mp157c-ev1
# =========================================================================
# Define the board reference devicetree name
# WARNING: only one setting allowed
#CUBEMX_BOARD_REFERENCE ?= "stm32mp157a-dk1"
#CUBEMX_BOARD_REFERENCE ?= "stm32mp157c-dk2"
CUBEMX_BOARD_REFERENCE ?= "stm32mp157c-ev1"

# CubeMX Project Config
# =========================================================================
# Assign CubeMX Board devicetree and project path name
#CUBEMX_DTB = "stm32mp157c-defaultmxconfig-mx"
#CUBEMX_PROJECT = "STM32MP157C-DK2/DefaultMXConfig/DeviceTree/DefaultMXConfig"
#CUBEMX_PROJECT = "STM32MP157C-EV1/DefaultMXConfig/DeviceTree/DefaultMXConfig"
```

## conf/machine/include/stm32mp1-mx-extlinux-config.inc
```bitbake
# =========================================================================
# EXTLINUX is dynamic according to FLASHLAYOUT CONFIG set
# =========================================================================

# -----------------------------------------------------------------------------
# CubeMX configuration
# -----------------------------------------------------------------------------
# Define targets to use: configure only CubeMX machine to add CubeMX label(s) only
UBOOT_EXTLINUX_TARGETS_emmc         = "targetcubemx_emmc"
UBOOT_EXTLINUX_TARGETS_emmc-optee   = "targetcubemx_emmc-optee"
UBOOT_EXTLINUX_TARGETS_nand         = "targetcubemx_nand"
UBOOT_EXTLINUX_TARGETS_nor-emmc     = "targetcubemx_nor-emmc"
UBOOT_EXTLINUX_TARGETS_nor-sdcard   = "targetcubemx_nor-sdcard"
UBOOT_EXTLINUX_TARGETS_sdcard       = "targetcubemx_sdcard"
UBOOT_EXTLINUX_TARGETS_sdcard-optee = "targetcubemx_sdcard-optee"
# Define bootprefix for each target
UBOOT_EXTLINUX_BOOTPREFIXES_targetcubemx_emmc         = "${EXTLINUX_BOOTDEVICE_EMMC}_${CUBEMX_BOARD_REFERENCE}_"
UBOOT_EXTLINUX_BOOTPREFIXES_targetcubemx_emmc-optee   = "${EXTLINUX_BOOTDEVICE_EMMC}_${CUBEMX_BOARD_REFERENCE}-optee_"
UBOOT_EXTLINUX_BOOTPREFIXES_targetcubemx_nand         = "${EXTLINUX_BOOTDEVICE_NAND}_${CUBEMX_BOARD_REFERENCE}_"
UBOOT_EXTLINUX_BOOTPREFIXES_targetcubemx_nor-sdcard   = "${EXTLINUX_BOOTDEVICE_NORSDCARD}_${CUBEMX_BOARD_REFERENCE}_"
UBOOT_EXTLINUX_BOOTPREFIXES_targetcubemx_nor-emmc     = "${EXTLINUX_BOOTDEVICE_NOREMMC}_${CUBEMX_BOARD_REFERENCE}_"
UBOOT_EXTLINUX_BOOTPREFIXES_targetcubemx_sdcard       = "${EXTLINUX_BOOTDEVICE_SDCARD}_${CUBEMX_BOARD_REFERENCE}_"
UBOOT_EXTLINUX_BOOTPREFIXES_targetcubemx_sdcard-optee = "${EXTLINUX_BOOTDEVICE_SDCARD}_${CUBEMX_BOARD_REFERENCE}-optee_"
# Define labels for each target
UBOOT_EXTLINUX_LABELS_targetcubemx_emmc         = "cubemx-emmc"
UBOOT_EXTLINUX_LABELS_targetcubemx_emmc-optee   = "cubemx-emmc-optee"
UBOOT_EXTLINUX_LABELS_targetcubemx_nand         = "cubemx-nand"
UBOOT_EXTLINUX_LABELS_targetcubemx_nor-sdcard   = "cubemx-nor-sdcard"
UBOOT_EXTLINUX_LABELS_targetcubemx_nor-emmc     = "cubemx-nor-emmc"
UBOOT_EXTLINUX_LABELS_targetcubemx_sdcard       = "cubemx-sdcard"
UBOOT_EXTLINUX_LABELS_targetcubemx_sdcard-optee = "cubemx-sdcard-optee"
# Define default boot config for each target
UBOOT_EXTLINUX_DEFAULT_LABEL_targetcubemx_emmc         ?= "cubemx-emmc"
UBOOT_EXTLINUX_DEFAULT_LABEL_targetcubemx_emmc-optee   ?= "cubemx-emmc-optee"
UBOOT_EXTLINUX_DEFAULT_LABEL_targetcubemx_nand         ?= "cubemx-nand"
UBOOT_EXTLINUX_DEFAULT_LABEL_targetcubemx_nor-sdcard   ?= "cubemx-nor-sdcard"
UBOOT_EXTLINUX_DEFAULT_LABEL_targetcubemx_nor-emmc     ?= "cubemx-nor-emmc"
UBOOT_EXTLINUX_DEFAULT_LABEL_targetcubemx_sdcard       ?= "cubemx-sdcard"
UBOOT_EXTLINUX_DEFAULT_LABEL_targetcubemx_sdcard-optee ?= "cubemx-sdcard-optee"
# Define FDT overrides for all labels
UBOOT_EXTLINUX_FDT_cubemx-emmc       = "/${CUBEMX_DTB_SET}.dtb"
UBOOT_EXTLINUX_FDT_cubemx-emmc-optee = "/${CUBEMX_DTB_SET}.dtb"
UBOOT_EXTLINUX_FDT_cubemx-nand       = "/${CUBEMX_DTB_SET}.dtb"
UBOOT_EXTLINUX_FDT_cubemx-nor-emmc   = "/${CUBEMX_DTB_SET}.dtb"
UBOOT_EXTLINUX_FDT_cubemx-nor-sdcard = "/${CUBEMX_DTB_SET}.dtb"
UBOOT_EXTLINUX_FDT_cubemx-sdcard        = "/${CUBEMX_DTB_SET}.dtb"
UBOOT_EXTLINUX_FDT_cubemx-sdcard-optee  = "/${CUBEMX_DTB_SET}.dtb"
# Define ROOT overrides for all labels
UBOOT_EXTLINUX_ROOT_cubemx-emmc         = "${EXTLINUX_ROOT_EMMC}"
UBOOT_EXTLINUX_ROOT_cubemx-emmc-optee   = "${EXTLINUX_ROOT_EMMC_OPTEE}"
UBOOT_EXTLINUX_ROOT_cubemx-nand         = "${EXTLINUX_ROOT_NAND}"
UBOOT_EXTLINUX_ROOT_cubemx-nor-emmc     = "${EXTLINUX_ROOT_NOREMMC}"
UBOOT_EXTLINUX_ROOT_cubemx-nor-sdcard   = "${EXTLINUX_ROOT_NORSDCARD}"
UBOOT_EXTLINUX_ROOT_cubemx-sdcard       = "${EXTLINUX_ROOT_SDCARD}"
UBOOT_EXTLINUX_ROOT_cubemx-sdcard-optee = "${EXTLINUX_ROOT_SDCARD_OPTEE}"
```

## conf/machine/stm32mp1-mx.conf
```bitbake
#@TYPE: Machine
#@NAME: stm32mp1-mx
#@DESCRIPTION: Configuration for STM32CubeMX generated project
#@NEEDED_BSPLAYERS: layers/meta-openembedded/meta-oe layers/meta-openembedded/meta-python

include conf/machine/include/st-machine-common-stm32mp.inc
include conf/machine/include/stm32mp1-mx-config.inc
include conf/machine/include/stm32mp1-mx-extlinux-config.inc
include conf/machine/include/stm32mp1-mx-common.inc

# =========================================================================
# CubeMX extra config
# =========================================================================
# Set specific path by components for DT file location
CUBEMX_DTB_PATH_TFA     = "${STM32MP_MX_BASE}/mx/${CUBEMX_PROJECT}/tf-a"
CUBEMX_DTB_PATH_UBOOT   = "${STM32MP_MX_BASE}/mx/${CUBEMX_PROJECT}/u-boot"
CUBEMX_DTB_PATH_LINUX   = "${STM32MP_MX_BASE}/mx/${CUBEMX_PROJECT}/kernel"
CUBEMX_DTB_PATH_OPTEEOS = "${STM32MP_MX_BASE}/mx/${CUBEMX_PROJECT}/optee-os"

# =========================================================================
# User customizing sections
# =========================================================================

# Boot Scheme
# =========================================================================
# DISCO / EVAL : basic, trusted or optee
# =========================================================================
#BOOTSCHEME_LABELS += "basic"
#BOOTSCHEME_LABELS += "trusted"
#BOOTSCHEME_LABELS += "optee"

# Boot Device Choice
# =========================================================================
# DISCO : sdcard
# EVAL  : sdcard, emmc, nand-4-256, nor-sdcard, nor-emmc or nor-nand-4-256
# =========================================================================
# Define the boot device supported
#BOOTDEVICE_LABELS += "sdcard"

# WARNING: configs below are only available with EVAL board
#BOOTDEVICE_LABELS += "emmc"
#BOOTDEVICE_LABELS += "nand-4-256"
#BOOTDEVICE_LABELS += "nor-emmc"
#BOOTDEVICE_LABELS += "nor-nand-4-256"
#BOOTDEVICE_LABELS += "nor-sdcard"

# Board Type Choice
# =========================================================================
# DISCO : stm32mp157a-dk1 or stm32mp157c-dk2
# EVAL  : stm32mp157c-ev1
# =========================================================================
# Define the board reference devicetree name
# WARNING: only one setting allowed
#CUBEMX_BOARD_REFERENCE = "stm32mp157a-dk1"
#CUBEMX_BOARD_REFERENCE = "stm32mp157c-dk2"
#CUBEMX_BOARD_REFERENCE = "stm32mp157c-ev1"

# CubeMX Project Config
# =========================================================================
# Assign CubeMX Board devicetree and project path name
#CUBEMX_DTB = "stm32mp157c-my-demo"
#CUBEMX_PROJECT = "STM32MP157C-EV1/my-demo/DeviceTree/my-demo"
```
